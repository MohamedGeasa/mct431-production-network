## firmware/inspection/main/Kconfig.projbuild
```kconfig
menu "MCT431 inspection network"
    config MCT_WIFI_SSID
        string "Gateway hotspot SSID"
        default "MCT431-Lab"
    config MCT_WIFI_PASSWORD
        string "Gateway hotspot password"
        default ""
        help
            Set locally with menuconfig. sdkconfig is ignored by Git.
endmenu
```

## firmware/inspection/sdkconfig.defaults
```kconfig
CONFIG_IDF_TARGET="esp32"
CONFIG_FREERTOS_HZ=1000
CONFIG_MCT_WIFI_SSID="MCT431-Lab"
```

## firmware/production/sdkconfig.defaults
```kconfig
CONFIG_IDF_TARGET="esp32"
CONFIG_ESP_CONSOLE_NONE=y
CONFIG_LOG_DEFAULT_LEVEL_NONE=y
CONFIG_BOOTLOADER_LOG_LEVEL_NONE=y
CONFIG_FREERTOS_HZ=1000
```
